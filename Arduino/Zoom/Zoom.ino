#include <IRremote.h>

const int receiverPin = 11; // Pin al que está conectado el receptor IR
IRrecv irrecv(receiverPin);
decode_results results;

const unsigned long ignoredCodes[] = {
  0x1FB029A, 0x48E10806, 0xB0E7BAA4, 0x57029A6A, 0x727E17BC,
  0xA38507A6, 0x9E417EE2, 0x1449CA15, 0xFB498C3, 0x5B4425E4,
  0xAC7ADB6, 0x8D6FB9C7, 0x66D39B7B, 0x92C709D, 0xDC34457B,
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  0xE20972B0, 0x87D50F41, 0x2ED33F0F, 0x83D09E48, 0x5FF59419
};

const unsigned long zoomInCodes[] = {
  0x97DEB5BE, 0xCCF50B7C, 0x8BDB3D6, 0x73FA09CA,
  0x25215AD3, 0x25E13EBD, 0x2E8930AD, 0xD55E3CEE,
  0xBCEB632B, 0xDC1CC68F, 0x69C2CB2E, 0x297B60E2,
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  0x48EED928, 0x259205A, 0x8D5E2428, 0xCC14FFC3,
  0xAB01722D
};


const int numIgnoredCodes = sizeof(ignoredCodes) / sizeof(ignoredCodes[0]);
const int numZoomInCodes = sizeof(zoomInCodes) / sizeof(zoomInCodes[0]);

void setup() {
  Serial.begin(9600);
  irrecv.enableIRIn(); // Iniciar el receptor IR
}

bool isIgnored(unsigned long code) {
  for (int i = 0; i < numIgnoredCodes; i++) {
    if (code == ignoredCodes[i]) {
      return true;
    }
  }
  return false;
}

bool isZoomIn(unsigned long code) {
  for (int i = 0; i < numZoomInCodes; i++) {
    if (code == zoomInCodes[i]) {
      return true;
    }
  }
  return false;
}

void loop() {
  if (irrecv.decode(&results)) {
   
   if (isIgnored(results.value)) {
      irrecv.resume(); // Reanudar el receptor y continuar con el siguiente código
      return; // Salir de la función loop para ignorar este código
    }
     // Mostrar el código recibido en hexadecimal
    if(results.value != 0xFB55006D){
      Serial.print("Código IR recibido: ");
      Serial.println(results.value, HEX);

      // Verificar el código y enviar un mensaje específico
      // Códigos para hacer zoom in
     if (isZoomIn(results.value)) {
    Serial.println("ZOOM_IN"); // Mensaje específico para hacer zoom in
}

      // Códigos para hacer zoom out
      else if (results.value == 0x64BBC0B4) { // Reemplaza con el código IR para zoom out
        Serial.println("ZOOM_OUT"); // Mensaje específico para hacer zoom out
      }
      // Códigos para girar a la derecha
      else if (results.value == 0x42461576) {
        Serial.println("GIRO_DERECHA"); // Mensaje específico para girar a la derecha
      }
    }
    irrecv.resume(); // Reanudar el receptor para recibir el siguiente código
  }
}
